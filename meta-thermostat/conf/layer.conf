## meta-thermostat/conf/layer.conf
```bitbake
# Layer configuration for meta-thermostat
# Copyright 2017 Northern.tech AS

# We have a conf and classes directory, add to BBPATH
BBPATH .= ":${LAYERDIR}"

# We have recipes-* directories, add to BBFILES
BBFILES += "${LAYERDIR}/recipes-*/*/*.bb \
        ${LAYERDIR}/recipes-*/*.bb \
        ${LAYERDIR}/recipes-*/*/*.bbappend"

BBFILE_COLLECTIONS += "thermostat"
BBFILE_PATTERN_thermostat = "^${LAYERDIR}/"
BBFILE_PRIORITY_thermostat = "6"
```
